## drivers/leds/aw20198/Kconfig
```kconfig
config LEDS_AW20198
	tristate "LED Support for AW20198"
	depends on LEDS_CLASS && I2C
	help
	  this option enables support for the AW20198 RGB LED connected
	  through I2C. Say Y to enable support for the AW20198 LED
	  light automatically.
```

## drivers/leds/aw2023/Kconfig
```kconfig
config LEDS_AW2023
	tristate "LED Support for AW2023"
	depends on LEDS_CLASS && I2C
	help
		this option enables support for the AW2023 RGB LED connected
		through I2C. Say Y to enable support for the AW2023 LED
```

## drivers/misc/aw8697_haptic/Kconfig
```kconfig
config HAPTIC_FEEDBACK
    tristate "Haptic driver feedback for awinic aw8697 series"
    help
      This option enables support for aw8697 series Haptic Driver Feedback.
```

## drivers/power/Kconfig
```kconfig
# SPDX-License-Identifier: GPL-2.0-only
source "drivers/power/reset/Kconfig"
source "drivers/power/supply/Kconfig"

#ifdef OPLUS_FEATURE_CHG_BASIC
config OPLUS_CHG
	tristate "OPLUS CHARGER KO module"
	default n
	help
	  Enables support for the oplus charging framework

config OPLUS_SM8550_CHARGER
	bool "OPLUS SM8550 charger driver"
	help
	  Enables support for the sm8550 charging

config OPLUS_SHORT_C_BATT_CHECK
	bool "OPLUS_SHORT_C_BATT CHECK SUPPORT"
	default n
	help
	  Say Y to include support

config OPLUS_CALL_MODE_SUPPORT
	bool "OPLUS call mode support"
	help
	  Say Y to include support

config OPLUS_SMART_CHARGER_SUPPORT
	bool "OPLUS smart charger support"
	help
	  Say Y to include support

config OPLUS_SHORT_HW_CHECK
	bool "OPLUS_SHORT_HW CHECK SUPPORT"
	default n
	help
	  Say Y to include support

config OPLUS_CHIP_SOC_NODE
	bool "OPLUS chip soc node"
	help
	  Say Y to include support

config OPLUS_SHORT_IC_CHECK
	bool "OPLUS_SHORT_IC CHECK SUPPORT"
	default n
	help
	  Say Y to include support

config OPLUS_SHORT_USERSPACE
	bool "OPLUS batt userspace"
	help
	 Say Y to include support

config OPLUS_RTC_DET_SUPPORT
	bool "OPLUS RTC DET SUPPORT"
	default n
	help
	  Say Y to include support

config OPLUS_CHECK_CHARGERID_VOLT
	bool "OPLUS CHECK CHARGERID VOLT"
	default n
	help
	  Say Y to include support

config OPLUS_SHIP_MODE_SUPPORT
	bool "OPLUS_SHIP_MODE_SUPPORT"
	default n
	help
	  Say Y to include support

config OPLUS_CHG_DYNAMIC_CONFIG
	bool "OPLUS_CHG_DYNAMIC_CONFIG"
	default n
	help
	  Say Y to include support

config DISABLE_OPLUS_FUNCTION
	bool "DISABLE_OPLUS_FUNCTION for bringup compile"
	default n
	help
	  Say Y to include support

config OPLUS_CHG_DRM_PANEL_NOTIFY
	bool "OPLUS_CHG_DRM_PANEL_NOTIFY"
	default n
	help
	  Say Y to include support

source "drivers/power/oplus/Kconfig"

menuconfig OPLUS_CHG_V2
	tristate "OPLUS charging V2 system"
	default n
	depends on I2C
	select REGMAP_I2C
	help
	  Say Y here to enable OPLUS charging V2 system support

if OPLUS_CHG_V2
config OPLUS_CHG_IC_DEBUG
	bool "Virtual IC layer debug interface"
	help
	  Say Y here to declare virtual IC layer debug interface

config OPLUS_CHG_MMS_DEBUG
	bool "Message subscription layer debug interface"
	help
	  Say Y here to declare message subscription layer debug interface

config OPLUS_DA9313_CHARGER
	bool "DA9313 support"
	help
	  Say Y here to declare DA9313 support

config OPLUS_MP2762_CHARGER
	bool "MP2762 support"
	help
	  Say Y here to declare MP2762 support

config OPLUS_SGM41512_CHARGER
	bool "SGM41512 support"
	help
	  Say Y here to declare SGM41512 support

config OPLUS_PD_MANAGER_CHARGER
	bool "PD_MANAGER support"
	help
	  Say Y here to declare PD_MANAGER support

config OPLUS_ADSP_CHARGER
	bool "ADSP support"
	help
	  Say Y here to declare ADSP support

config OPLUS_WIRELESS_NU1619
	bool "oplus wireless nu1619 support"
	help
	  Say Y here to declare wireless nu1619 support

config OPLUS_WIRELESS_P9415
	bool "oplus wireless p9415 support"
	help
	  Say Y here to declare wireless p9415 support

config OPLUS_CHARGEPUMP_HL7227
	bool "oplus chargepump hl7227 support"
	help
	  Say Y here to declare chargepump hl7227 support

menuconfig OPLUS_CHG_VOOCPHY
	bool "OPLUS charging voocphy"
	help
	  Say Y here to enable OPLUS charging system support

if OPLUS_CHG_VOOCPHY
config OPLUS_CHG_VOOCPHY_CHGLIB
	bool "voocphy chglib support"
	help
	  Say Y here to declare voocphy chglib support

config OPLUS_CHG_AP_VOOCPHY
	bool "ap voocphy support"
	depends on OPLUS_CHG_VOOCPHY_CHGLIB
	help
          Say Y here to declare ap voocphy support

config OPLUS_CHG_ADSP_VOOCPHY
	bool "adsp voocphy support"
	depends on OPLUS_CHG_VOOCPHY_CHGLIB
	help
          Say Y here to declare adsp voocphy support

endif #OPLUS_CHG_VOOCPHY
endif

#endif
```

## drivers/soc/Kconfig
```kconfig
# SPDX-License-Identifier: GPL-2.0-only
menu "SOC (System On Chip) specific Drivers"

source "drivers/soc/actions/Kconfig"
source "drivers/soc/amlogic/Kconfig"
source "drivers/soc/apple/Kconfig"
source "drivers/soc/aspeed/Kconfig"
source "drivers/soc/atmel/Kconfig"
source "drivers/soc/bcm/Kconfig"
source "drivers/soc/canaan/Kconfig"
source "drivers/soc/fsl/Kconfig"
source "drivers/soc/fujitsu/Kconfig"
source "drivers/soc/imx/Kconfig"
source "drivers/soc/ixp4xx/Kconfig"
source "drivers/soc/litex/Kconfig"
source "drivers/soc/mediatek/Kconfig"
source "drivers/soc/microchip/Kconfig"
source "drivers/soc/pxa/Kconfig"
source "drivers/soc/qcom/Kconfig"
source "drivers/soc/renesas/Kconfig"
source "drivers/soc/rockchip/Kconfig"
source "drivers/soc/samsung/Kconfig"
source "drivers/soc/sifive/Kconfig"
source "drivers/soc/sunxi/Kconfig"
source "drivers/soc/tegra/Kconfig"
source "drivers/soc/ti/Kconfig"
source "drivers/soc/ux500/Kconfig"
source "drivers/soc/versatile/Kconfig"
source "drivers/soc/xilinx/Kconfig"

#ifdef OPLUS_FEATURE_MM_FEEDBACK
source "drivers/soc/oplus/multimedia/Kconfig"
#endif /* OPLUS_FEATURE_MM_FEEDBACK */

#ifdef OPLUS_FEATURE_OCH
source "kernel/oplus_cpu/cpufreq_health/Kconfig"
#endif /* OPLUS_FEATURE_OCH */

source "kernel/oplus_cpu/uad/Kconfig"

#ifdef OPLUS_FEATURE_OMRG
source "kernel/oplus_cpu/oplus_omrg/Kconfig"
#endif /* OPLUS_FEATURE_OMRG */

#ifdef OPLUS_FEATURE_GKI_CPUFREQ_BOUNCING
source "kernel/oplus_cpu/cpufreq_bouncing/Kconfig"
#endif /* OPLUS_FEATURE_GKI_CPUFREQ_BOUNCING */

#ifdef OPLUS_FEATURE_ABNORMAL_FLAG
source "kernel/oplus_cpu/oplus_overload/Kconfig"
#endif /* OPLUS_FEATURE_ABNORMAL_FLAG */

#ifdef OPLUS_FEATURE_BOOT
source "drivers/soc/oplus/boot/cmdline_parser/Kconfig"
source "drivers/soc/oplus/boot/bootloader_log/Kconfig"
source "drivers/soc/oplus/boot/oplus_projectinfo/Kconfig"
source "drivers/soc/oplus/boot/bootmode/Kconfig"
source "drivers/soc/oplus/boot/htb/Kconfig"
#endif /* OPLUS_FEATURE_BOOT */

#ifdef OPLUS_FEATURE_QCOM_WATCHDOG
source "drivers/soc/oplus/boot/qcom_watchdog/Kconfig"
#endif

#ifdef OPLUS_FEATURE_MODEM_MINIDUMP
source "drivers/soc/oplus/mdmrst/Kconfig"
#endif /*OPLUS_FEATURE_MODEM_MINIDUMP*/

endmenu

#ifdef OPLUS_FEATURE_TP_BASIC
source "drivers/soc/oplus/device_info/Kconfig"
#endif /* OPLUS_FEATURE_TP_BASIC */

#ifdef OPLUS_FEATURE_DFT
source "drivers/soc/oplus/dft/Kconfig"
#endif /* OPLUS_FEATURE_DFT */

source "drivers/soc/oplus/storage/Kconfig"

#ifdef OPLUS_SUBSYS_SLEEP_MONITOR
source "drivers/soc/oplus/power/subsys_sleep_monitor/Kconfig"
#endif /* OPLUS_SUBSYS_SLEEP_MONITOR */
```
